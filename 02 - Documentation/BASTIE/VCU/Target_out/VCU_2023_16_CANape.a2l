/******************************************************************************
* ASAP2 file: VCU_2023.a2l
* Academic License - for use in teaching, academic research, and meeting
* course requirements at degree granting institutions only. Not for
* government, commercial, or other organizational use.
* Code generation for model "VCU_2023".
* Model version : 1.1606
* Simulink Coder version : 9.3 (R2020a) 18-Nov-2019
* C source code generated on : Fri Oct 10 13:02:11 2025
* Target selection: MPC5644A.tlc
* Embedded hardware selection: Freescale->MPC55xx
* Code generation objectives: Unspecified
* Validation result: Not run
* (add additional file header information here)
******************************************************************************/ ASAP2_VERSION 1 31
/* Version 1.31 */
/begin PROJECT ProjectName "Project Comment Goes Here"
/begin HEADER "Header Comments go here" /end HEADER
/begin MODULE ModuleName "Module Comment Goes Here"
/* EcoCoder V2.9.5 R2 Target:EV2274A verCalTool:0.0*/
/* XCP-En:0 XCPCalTool:CANape CANape XCP-CAN:CAN_CTRL_C XCP-CAN-Baud:500kbps*/
/* CCP-En:1 CCP-TYPE:Configurable CCPCalTool:CANape CCP-CAN:CAN_CTRL_C CCP-CAN-Baud:500kbps*/
/*PGCANAEn:NoUse PGCANAStation:NoUse PGCANABaud:500kbps PGCANACRO:NoUse PGCANADTO:NoUse*/
/*PGCANBEn:NoUse PGCANBStation:NoUse PGCANBBaud:NoUsekbps PGCANBCRO:NoUse PGCANBDTO:NoUse*/
/*PGCANCEn:NoUse PGCANCStation:NoUse PGCANCBaud:500kbps PGCANCCRO:NoUse PGCANCDTO:NoUse*/
/*PGCANDEn:NoUse PGCANDStation:NoUse PGCANDBaud:NoUsekbps PGCANDCRO:NoUse PGCANDDTO:NoUse*/
/*ECO_XCP_Note_Start
/begin IF_DATA XCP
/begin PROTOCOL_LAYER
0x0100
0x07D0
0x2710
0x3E8
0x2710
0x3E8
0x19
0x19
0x08
0x08
BYTE_ORDER_MSB_FIRST
ADDRESS_GRANULARITY_BYTE
OPTIONAL_CMD ALLOC_ODT_ENTRY
OPTIONAL_CMD ALLOC_ODT
OPTIONAL_CMD ALLOC_DAQ
OPTIONAL_CMD FREE_DAQ
OPTIONAL_CMD GET_DAQ_EVENT_INFO
OPTIONAL_CMD GET_DAQ_RESOLUTION_INFO
OPTIONAL_CMD GET_DAQ_PROCESSOR_INFO
OPTIONAL_CMD START_STOP_SYNCH
OPTIONAL_CMD START_STOP_DAQ_LIST
OPTIONAL_CMD GET_DAQ_LIST_MODE
OPTIONAL_CMD SET_DAQ_LIST_MODE
OPTIONAL_CMD WRITE_DAQ
OPTIONAL_CMD SET_DAQ_PTR
OPTIONAL_CMD CLEAR_DAQ_LIST
OPTIONAL_CMD DOWNLOAD
OPTIONAL_CMD SHORT_UPLOAD
OPTIONAL_CMD UPLOAD
OPTIONAL_CMD SET_MTA
OPTIONAL_CMD UNLOCK
OPTIONAL_CMD GET_SEED
OPTIONAL_CMD GET_ID
OPTIONAL_CMD GET_COMM_MODE_INFO
OPTIONAL_CMD BUILD_CHECKSUM
SEED_AND_KEY_EXTERNAL_FUNCTION ""
/end PROTOCOL_LAYER
/begin DAQ
DYNAMIC
0x00
0x05
0x00
OPTIMISATION_TYPE_DEFAULT
ADDRESS_EXTENSION_FREE
IDENTIFICATION_FIELD_TYPE_ABSOLUTE
GRANULARITY_ODT_ENTRY_SIZE_DAQ_BYTE
0x07
OVERLOAD_INDICATION_PID
/begin STIM
GRANULARITY_ODT_ENTRY_SIZE_STIM_BYTE
0x07
/end STIM
/begin EVENT
"5ms"
"5ms"
0x00
DAQ
0x01
0x05
0x06
0x00
/end EVENT
/begin EVENT
"20ms"
"20ms"
0x01
DAQ
0x01
0x02
0x07
0x00
/end EVENT
/begin EVENT
"50ms"
"50ms"
0x02
DAQ
0x01
0x05
0x07
0x00
/end EVENT
/begin EVENT
"100ms"
"100ms"
0x03
DAQ
0x01
0x01
0x08
0x00
/end EVENT
/begin EVENT
"200ms"
"200m"
0x04
DAQ
0x01
0x02
0x08
0x00
/end EVENT
/end DAQ
/begin PAG
0x00
/end PAG
/begin PGM
PGM_MODE_ABSOLUTE
0x00
0x00
/end PGM
/begin XCP_ON_CAN
0x0100
CAN_ID_MASTER 0x100
CAN_ID_SLAVE 0x101
BAUDRATE 500000
SAMPLE_POINT 0x4B
SAMPLE_RATE SINGLE
BTL_CYCLES 0x08
SJW 0x02
SYNC_EDGE SINGLE
/end XCP_ON_CAN
/end IF_DATA
/begin IF_DATA CANAPE_ADDRESS_UPDATE
/end IF_DATA
/begin MOD_PAR "_default_ModParComment"
/begin MEMORY_SEGMENT _ROMCAL
"calibration_rom"
DATA
FLASH
INTERN
0x00FD0000
0x8000
-1 -1 -1 -1 -1
/begin IF_DATA XCP
/begin SEGMENT
0x00
0x01
0x00
0x00
0x00
/begin CHECKSUM
XCP_CRC_16_CITT
MAX_BLOCK_SIZE 0xFFFF
EXTERNAL_FUNCTION "String.Empty"
/end CHECKSUM
/begin PAGE
0x00
ECU_ACCESS_DONT_CARE
XCP_READ_ACCESS_DONT_CARE
XCP_WRITE_ACCESS_DONT_CARE
INIT_SEGMENT 0x00
/end PAGE
/begin ADDRESS_MAPPING
0x00FD0000
0x40000000
0x8000
/end ADDRESS_MAPPING
/end SEGMENT
/end IF_DATA
/end MEMORY_SEGMENT
/begin MEMORY_SEGMENT _CODE
"ecu_code"
CODE
FLASH
INTERN
0x01000200
0x1FFA00
-1 -1 -1 -1 -1
/end MEMORY_SEGMENT
/end MOD_PAR
ECO_XCP_Note_End*/
/*ECO_CCP_Note_Start*/
/begin MOD_PAR "_default_ModParComment" ADDR_EPK 0x01000100 EPK "2025-10-10 13:02:12" /*EcoCoderINCAStart
/begin MEMORY_SEGMENT _RAMCAL
"calibration_ram"
DATA
RAM
INTERN
0x40000000
0x8000
-1 -1 -1 -1 -1
/end MEMORY_SEGMENT
EcoCoderINCAEnd*/
 /begin MEMORY_SEGMENT _ROMCAL "calibration_rom" DATA FLASH INTERN 0x00FD0000 0x8000 -1 -1 -1 -1 -1
  /begin IF_DATA ASAP1B_CCP /*EcoCoderINCAStart
ADDRESS_MAPPING 0x00FD0000 0x40000000 0x8000
EcoCoderINCAEnd*/ ADDR_MAPPING 0x00FD0000 0x40000000 0x8000 /end IF_DATA
 /end MEMORY_SEGMENT
 /begin MEMORY_SEGMENT _epk_data "epk_data" DATA FLASH INTERN 0x01000100 0xFF -1 -1 -1 -1 -1
  /begin IF_DATA ASAP1B_CCP /*EcoCoderINCAStart
ADDRESS_MAPPING 0x01000100 0x01000100 0xFF
EcoCoderINCAEnd*/ ADDR_MAPPING 0x01000100 0x01000100 0xFF /end IF_DATA
 /end MEMORY_SEGMENT
 /begin MEMORY_SEGMENT _CODE "ecu_code" CODE FLASH INTERN 0x01000200 0x1FFA00 -1 -1 -1 -1 -1 /end MEMORY_SEGMENT
/end MOD_PAR
/begin IF_DATA ASAP1B_CCP
 /begin SOURCE "20ms" 3 20 DISPLAY_IDENTIFIER DAQ2
  /begin QP_BLOB 1 LENGTH 0x20 CAN_ID_FIXED 0x101 RASTER 1 REDUCTION_ALLOWED FIRST_PID 0x3C /end QP_BLOB
 /end SOURCE
 /begin SOURCE "100ms" 3 100 DISPLAY_IDENTIFIER DAQ3
  /begin QP_BLOB 2 LENGTH 0x30 CAN_ID_FIXED 0x101 RASTER 2 REDUCTION_ALLOWED FIRST_PID 0x78 /end QP_BLOB
 /end SOURCE
 /begin RASTER "20ms" "20ms" 1 3 20 /end RASTER
 /begin RASTER "100ms" "100ms" 2 3 100 /end RASTER
 /begin SEED_KEY "" "" "" /end SEED_KEY
 /begin CHECKSUM "CRC16.dll" /end CHECKSUM
 /begin TP_BLOB 0x0201 0x0204 0x100 0x101 0x112 1 BAUDRATE 500000 SAMPLE_POINT 70 SAMPLE_RATE 1 BTL_CYCLES 10 SJW 1 SYNC_EDGE SINGLE DAQ_MODE 0 CONSISTENCY 1 ADDRESS_EXTENSION 0 RESUME_SUPPORTED STORE_SUPPORTED
  /begin CHECKSUM_PARAM /*EcoCoderINCAStart
0x9001
EcoCoderINCAEnd*/ 0x0C 0xffffffff CHECKSUM_CALCULATION ACTIVE_PAGE /end CHECKSUM_PARAM
  /begin DEFINED_PAGES 0x00 "RAM_PAGE" 0x00 0x40000000 0x8000 RAM RAM_INIT_BY_ECU /end DEFINED_PAGES
  OPTIONAL_CMD 0X5 OPTIONAL_CMD 0X8 OPTIONAL_CMD 0X9 OPTIONAL_CMD 0XC OPTIONAL_CMD 0XD OPTIONAL_CMD 0XE OPTIONAL_CMD 0XF OPTIONAL_CMD 0X10 OPTIONAL_CMD 0X11 OPTIONAL_CMD 0X12 OPTIONAL_CMD 0X13 OPTIONAL_CMD 0X18 OPTIONAL_CMD 0X19 OPTIONAL_CMD 0X20 OPTIONAL_CMD 0X21 OPTIONAL_CMD 0X22 OPTIONAL_CMD 0X23 /end TP_BLOB
/end IF_DATA
/*ECO_CCP_Note_End*/
/begin MOD_COMMON "" /* Comment */ ALIGNMENT_BYTE 1 ALIGNMENT_WORD 1 ALIGNMENT_LONG 1 ALIGNMENT_FLOAT32_IEEE 1 ALIGNMENT_FLOAT64_IEEE 1 BYTE_ORDER MSB_FIRST DEPOSIT ABSOLUTE /end MOD_COMMON
/begin RECORD_LAYOUT Scalar_BOOLEAN FNC_VALUES 1 UBYTE COLUMN_DIR DIRECT /end RECORD_LAYOUT
/begin RECORD_LAYOUT Scalar_UBYTE FNC_VALUES 1 UBYTE COLUMN_DIR DIRECT /end RECORD_LAYOUT
/begin RECORD_LAYOUT Scalar_BYTE FNC_VALUES 1 SBYTE COLUMN_DIR DIRECT /end RECORD_LAYOUT
/begin RECORD_LAYOUT Scalar_UWORD FNC_VALUES 1 UWORD COLUMN_DIR DIRECT /end RECORD_LAYOUT
/begin RECORD_LAYOUT Scalar_SWORD FNC_VALUES 1 SWORD COLUMN_DIR DIRECT /end RECORD_LAYOUT
/begin RECORD_LAYOUT Scalar_ULONG FNC_VALUES 1 ULONG COLUMN_DIR DIRECT /end RECORD_LAYOUT
/begin RECORD_LAYOUT Scalar_LONG FNC_VALUES 1 SLONG COLUMN_DIR DIRECT /end RECORD_LAYOUT
/begin RECORD_LAYOUT Scalar_FLOAT32_IEEE FNC_VALUES 1 FLOAT32_IEEE COLUMN_DIR DIRECT /end RECORD_LAYOUT
/begin RECORD_LAYOUT Scalar_FLOAT64_IEEE FNC_VALUES 1 FLOAT64_IEEE COLUMN_DIR DIRECT /end RECORD_LAYOUT
/begin RECORD_LAYOUT Lookup1D_BOOLEAN FNC_VALUES 1 UBYTE COLUMN_DIR DIRECT /end RECORD_LAYOUT
/begin RECORD_LAYOUT Lookup1D_X_BOOLEAN AXIS_PTS_X 1 UBYTE INDEX_INCR DIRECT /end RECORD_LAYOUT
/begin RECORD_LAYOUT Lookup1D_BYTE FNC_VALUES 1 SBYTE COLUMN_DIR DIRECT /end RECORD_LAYOUT
/begin RECORD_LAYOUT Lookup1D_X_BYTE AXIS_PTS_X 1 SBYTE INDEX_INCR DIRECT /end RECORD_LAYOUT
/begin RECORD_LAYOUT Lookup1D_UBYTE FNC_VALUES 1 UBYTE COLUMN_DIR DIRECT /end RECORD_LAYOUT
/begin RECORD_LAYOUT Lookup1D_X_UBYTE AXIS_PTS_X 1 UBYTE INDEX_INCR DIRECT /end RECORD_LAYOUT
/begin RECORD_LAYOUT Lookup1D_UWORD FNC_VALUES 1 UWORD COLUMN_DIR DIRECT /end RECORD_LAYOUT
/begin RECORD_LAYOUT Lookup1D_X_UWORD AXIS_PTS_X 1 UWORD INDEX_INCR DIRECT /end RECORD_LAYOUT
/begin RECORD_LAYOUT Lookup1D_WORD FNC_VALUES 1 SWORD COLUMN_DIR DIRECT /end RECORD_LAYOUT
/begin RECORD_LAYOUT Lookup1D_X_WORD AXIS_PTS_X 1 SWORD INDEX_INCR DIRECT /end RECORD_LAYOUT
/begin RECORD_LAYOUT Lookup1D_ULONG FNC_VALUES 1 ULONG COLUMN_DIR DIRECT /end RECORD_LAYOUT
/begin RECORD_LAYOUT Lookup1D_X_ULONG AXIS_PTS_X 1 ULONG INDEX_INCR DIRECT /end RECORD_LAYOUT
/begin RECORD_LAYOUT Lookup1D_SLONG FNC_VALUES 1 SLONG COLUMN_DIR DIRECT /end RECORD_LAYOUT
/begin RECORD_LAYOUT Lookup1D_X_LONG AXIS_PTS_X 1 SLONG INDEX_INCR DIRECT /end RECORD_LAYOUT
/begin RECORD_LAYOUT Lookup1D_FLOAT32_IEEE FNC_VALUES 1 FLOAT32_IEEE COLUMN_DIR DIRECT /end RECORD_LAYOUT
/begin RECORD_LAYOUT Lookup1D_X_FLOAT32_IEEE AXIS_PTS_X 1 FLOAT32_IEEE INDEX_INCR DIRECT /end RECORD_LAYOUT
/begin RECORD_LAYOUT Lookup1D_FLOAT64_IEEE FNC_VALUES 1 FLOAT64_IEEE COLUMN_DIR DIRECT /end RECORD_LAYOUT
/begin RECORD_LAYOUT Lookup1D_X_FLOAT64_IEEE AXIS_PTS_X 1 FLOAT64_IEEE INDEX_INCR DIRECT /end RECORD_LAYOUT
/begin RECORD_LAYOUT Lookup2D_BOOLEAN FNC_VALUES 1 UBYTE COLUMN_DIR DIRECT /end RECORD_LAYOUT
/begin RECORD_LAYOUT Lookup2D_X_BOOLEAN AXIS_PTS_X 1 UBYTE INDEX_INCR DIRECT /end RECORD_LAYOUT
/begin RECORD_LAYOUT Lookup2D_UBYTE FNC_VALUES 1 UBYTE COLUMN_DIR DIRECT /end RECORD_LAYOUT
/begin RECORD_LAYOUT Lookup2D_X_UBYTE AXIS_PTS_X 1 UBYTE INDEX_INCR DIRECT /end RECORD_LAYOUT
/begin RECORD_LAYOUT Lookup2D_BYTE FNC_VALUES 1 SBYTE COLUMN_DIR DIRECT /end RECORD_LAYOUT
/begin RECORD_LAYOUT Lookup2D_X_BYTE AXIS_PTS_X 1 SBYTE INDEX_INCR DIRECT /end RECORD_LAYOUT
/begin RECORD_LAYOUT Lookup2D_UWORD FNC_VALUES 1 UWORD COLUMN_DIR DIRECT /end RECORD_LAYOUT
/begin RECORD_LAYOUT Lookup2D_X_UWORD AXIS_PTS_X 1 UWORD INDEX_INCR DIRECT /end RECORD_LAYOUT
/begin RECORD_LAYOUT Lookup2D_WORD FNC_VALUES 1 SWORD COLUMN_DIR DIRECT /end RECORD_LAYOUT
/begin RECORD_LAYOUT Lookup2D_X_WORD AXIS_PTS_X 1 SWORD INDEX_INCR DIRECT /end RECORD_LAYOUT
/begin RECORD_LAYOUT Lookup2D_ULONG FNC_VALUES 1 ULONG COLUMN_DIR DIRECT /end RECORD_LAYOUT
/begin RECORD_LAYOUT Lookup2D_X_ULONG AXIS_PTS_X 1 ULONG INDEX_INCR DIRECT /end RECORD_LAYOUT
/begin RECORD_LAYOUT Lookup2D_LONG FNC_VALUES 1 SLONG COLUMN_DIR DIRECT /end RECORD_LAYOUT
/begin RECORD_LAYOUT Lookup2D_X_LONG AXIS_PTS_X 1 SLONG INDEX_INCR DIRECT /end RECORD_LAYOUT
/begin RECORD_LAYOUT Lookup2D_FLOAT32_IEEE FNC_VALUES 1 FLOAT32_IEEE COLUMN_DIR DIRECT /end RECORD_LAYOUT
/begin RECORD_LAYOUT Lookup2D_X_FLOAT32_IEEE AXIS_PTS_X 1 FLOAT32_IEEE INDEX_INCR DIRECT /end RECORD_LAYOUT
/begin RECORD_LAYOUT Lookup2D_FLOAT64_IEEE FNC_VALUES 1 FLOAT64_IEEE COLUMN_DIR DIRECT /end RECORD_LAYOUT
/begin RECORD_LAYOUT Lookup2D_X_FLOAT64_IEEE AXIS_PTS_X 1 FLOAT64_IEEE INDEX_INCR DIRECT /end RECORD_LAYOUT
/begin CHARACTERISTIC SOC_cur "" CURVE 0xfd0330 /* @ECU_Address@SOC_cur@ */ Lookup1D_UWORD 0 VCU_2023_CM_uint16 0 65535
 /begin AXIS_DESCR COM_AXIS NO_INPUT_QUANTITY VCU_2023_CM_single 201 -3.4E+38 3.4E+38 AXIS_PTS_REF SOC_bp /end AXIS_DESCR
/end CHARACTERISTIC
/begin CHARACTERISTIC Vdc_bus_V_cur "" CURVE 0xfd06c2 /* @ECU_Address@Vdc_bus_V_cur@ */ Lookup1D_WORD 0 VCU_2023_CM_int16 -32768 32767
 /begin AXIS_DESCR COM_AXIS NO_INPUT_QUANTITY VCU_2023_CM_int16 42 -32768 32767 AXIS_PTS_REF Vdc_bus_V_bp /end AXIS_DESCR
/end CHARACTERISTIC
/begin CHARACTERISTIC T_IGBT_conversion_cur "" CURVE 0xfd0510 /* @ECU_Address@T_IGBT_conversion_cur@ */ Lookup1D_WORD 0 VCU_2023_CM_int16 -32768 32767
 /begin AXIS_DESCR COM_AXIS NO_INPUT_QUANTITY VCU_2023_CM_int16 39 -32768 32767 AXIS_PTS_REF T_IGBT_conversion_bp /end AXIS_DESCR
/end CHARACTERISTIC
/begin CHARACTERISTIC T_motor_conversion_cur "" CURVE 0xfd0620 /* @ECU_Address@T_motor_conversion_cur@ */ Lookup1D_WORD 0 VCU_2023_CM_int16 -32768 32767
 /begin AXIS_DESCR COM_AXIS NO_INPUT_QUANTITY VCU_2023_CM_int16 39 -32768 32767 AXIS_PTS_REF T_motor_conversion_bp /end AXIS_DESCR
/end CHARACTERISTIC
/begin CHARACTERISTIC T_air_conversion_cur "" CURVE 0xfd0598 /* @ECU_Address@T_air_conversion_cur@ */ Lookup1D_WORD 0 VCU_2023_CM_int16 -32768 32767
 /begin AXIS_DESCR COM_AXIS NO_INPUT_QUANTITY VCU_2023_CM_int16 29 -32768 32767 AXIS_PTS_REF T_air_conversion_bp /end AXIS_DESCR
/end CHARACTERISTIC
/begin CHARACTERISTIC APPS1_max "" VALUE 0xfd0000 /* @ECU_Address@APPS1_max@ */ Scalar_SWORD 0 VCU_2023_CM_int16 -32768 32767 /end CHARACTERISTIC
/begin CHARACTERISTIC APPS1_min "" VALUE 0xfd0002 /* @ECU_Address@APPS1_min@ */ Scalar_SWORD 0 VCU_2023_CM_int16 -32768 32767 /end CHARACTERISTIC
/begin CHARACTERISTIC APPS2_max "" VALUE 0xfd0004 /* @ECU_Address@APPS2_max@ */ Scalar_SWORD 0 VCU_2023_CM_int16 -32768 32767 /end CHARACTERISTIC
/begin CHARACTERISTIC APPS2_min "" VALUE 0xfd0006 /* @ECU_Address@APPS2_min@ */ Scalar_SWORD 0 VCU_2023_CM_int16 -32768 32767 /end CHARACTERISTIC
/begin CHARACTERISTIC BRK_TH "" VALUE 0xfd0008 /* @ECU_Address@BRK_TH@ */ Scalar_SWORD 0 VCU_2023_CM_int16 -32768 32767 /end CHARACTERISTIC
/begin AXIS_PTS SOC_bp "" 0xfd000c /* @ECU_Address@SOC_bp@ */ NO_INPUT_QUANTITY Lookup1D_X_FLOAT32_IEEE 0 VCU_2023_CM_single 201 -3.4E+38 3.4E+38 /end AXIS_PTS
/begin AXIS_PTS Vdc_bus_V_bp "" 0xfd066e /* @ECU_Address@Vdc_bus_V_bp@ */ NO_INPUT_QUANTITY Lookup1D_X_WORD 0 VCU_2023_CM_int16 42 -32768 32767 /end AXIS_PTS
/begin AXIS_PTS T_IGBT_conversion_bp "" 0xfd04c2 /* @ECU_Address@T_IGBT_conversion_bp@ */ NO_INPUT_QUANTITY Lookup1D_X_WORD 0 VCU_2023_CM_int16 39 -32768 32767 /end AXIS_PTS
/begin AXIS_PTS T_motor_conversion_bp "" 0xfd05d2 /* @ECU_Address@T_motor_conversion_bp@ */ NO_INPUT_QUANTITY Lookup1D_X_WORD 0 VCU_2023_CM_int16 39 -32768 32767 /end AXIS_PTS
/begin AXIS_PTS T_air_conversion_bp "" 0xfd055e /* @ECU_Address@T_air_conversion_bp@ */ NO_INPUT_QUANTITY Lookup1D_X_WORD 0 VCU_2023_CM_int16 29 -32768 32767 /end AXIS_PTS
/begin MEASUREMENT DATA "" ULONG VCU_2023_CM_uint32 0 0 0 4294967295 ECU_ADDRESS 0x40018010 /* @ECU_Address@DATA@ */ /end MEASUREMENT
/begin MEASUREMENT DUTY_RRWS "" ULONG VCU_2023_CM_uint32 0 0 0 4294967295 ECU_ADDRESS 0x4001801c /* @ECU_Address@DUTY_RRWS@ */ /end MEASUREMENT
/begin MEASUREMENT DUTY_RLWS "" ULONG VCU_2023_CM_uint32 0 0 0 4294967295 ECU_ADDRESS 0x40018018 /* @ECU_Address@DUTY_RLWS@ */ /end MEASUREMENT
/begin MEASUREMENT VIT_MOY_ARR "" ULONG VCU_2023_CM_uint32 0 0 0 4294967295 ECU_ADDRESS 0x40018064 /* @ECU_Address@VIT_MOY_ARR@ */ /end MEASUREMENT
/begin MEASUREMENT VIT_RRWS "" ULONG VCU_2023_CM_uint32 0 0 0 4294967295 ECU_ADDRESS 0x40018070 /* @ECU_Address@VIT_RRWS@ */ /end MEASUREMENT
/begin MEASUREMENT VIT_RLWS "" ULONG VCU_2023_CM_uint32 0 0 0 4294967295 ECU_ADDRESS 0x4001806c /* @ECU_Address@VIT_RLWS@ */ /end MEASUREMENT
/begin MEASUREMENT VIT_MOY_ARR_corrige "" ULONG VCU_2023_CM_uint32 0 0 0 4294967295 ECU_ADDRESS 0x40018068 /* @ECU_Address@VIT_MOY_ARR_corrige@ */ /end MEASUREMENT
/begin MEASUREMENT APPS_1 "" UWORD VCU_2023_CM_uint16 0 0 0 65535 ECU_ADDRESS 0x40018006 /* @ECU_Address@APPS_1@ */ /end MEASUREMENT
/begin MEASUREMENT APPS1_calib "" UWORD VCU_2023_CM_uint16 0 0 0 65535 ECU_ADDRESS 0x40018002 /* @ECU_Address@APPS1_calib@ */ /end MEASUREMENT
/begin MEASUREMENT APPS_2 "" UWORD VCU_2023_CM_uint16 0 0 0 65535 ECU_ADDRESS 0x40018008 /* @ECU_Address@APPS_2@ */ /end MEASUREMENT
/begin MEASUREMENT APPS2_calib "" UWORD VCU_2023_CM_uint16 0 0 0 65535 ECU_ADDRESS 0x40018004 /* @ECU_Address@APPS2_calib@ */ /end MEASUREMENT
/begin MEASUREMENT BRK_PRESSURE "" UWORD VCU_2023_CM_uint16 0 0 0 65535 ECU_ADDRESS 0x4001800c /* @ECU_Address@BRK_PRESSURE@ */ /end MEASUREMENT
/begin MEASUREMENT TRQ_CMD_BAMOCAR "" UWORD VCU_2023_CM_uint16 0 0 0 65535 ECU_ADDRESS 0x40018050 /* @ECU_Address@TRQ_CMD_BAMOCAR@ */ /end MEASUREMENT
/begin MEASUREMENT N_lim "" UWORD VCU_2023_CM_uint16 0 0 0 65535 ECU_ADDRESS 0x40018040 /* @ECU_Address@N_lim@ */ /end MEASUREMENT
/begin MEASUREMENT N_100 "" UWORD VCU_2023_CM_uint16 0 0 0 65535 ECU_ADDRESS 0x40018038 /* @ECU_Address@N_100@ */ /end MEASUREMENT
/begin MEASUREMENT Vdc_bus_V "" SWORD VCU_2023_CM_int16_V 0 0 -32768 32767 ECU_ADDRESS 0x40018076 /* @ECU_Address@Vdc_bus_V@ */ /end MEASUREMENT
/begin MEASUREMENT I_act_filt_A "" SWORD VCU_2023_CM_int16_A 0 0 -32768 32767 ECU_ADDRESS 0x40018026 /* @ECU_Address@I_act_filt_A@ */ /end MEASUREMENT
/begin MEASUREMENT T_air_deg "" SWORD VCU_2023_CM_int16__C 0 0 -32768 32767 ECU_ADDRESS 0x4001805a /* @ECU_Address@T_air_deg@ */ /end MEASUREMENT
/begin MEASUREMENT T_motor_deg "" SWORD VCU_2023_CM_int16__C 0 0 -32768 32767 ECU_ADDRESS 0x4001805e /* @ECU_Address@T_motor_deg@ */ /end MEASUREMENT
/begin MEASUREMENT T_IGBT_deg "" SWORD VCU_2023_CM_int16__C 0 0 -32768 32767 ECU_ADDRESS 0x40018056 /* @ECU_Address@T_IGBT_deg@ */ /end MEASUREMENT
/begin MEASUREMENT N_R_Dec "" SWORD VCU_2023_CM_int16 0 0 -32768 32767 ECU_ADDRESS 0x4001803c /* @ECU_Address@N_R_Dec@ */ /end MEASUREMENT
/begin MEASUREMENT M_R_Dec "" SWORD VCU_2023_CM_int16 0 0 -32768 32767 ECU_ADDRESS 0x40018036 /* @ECU_Address@M_R_Dec@ */ /end MEASUREMENT
/begin MEASUREMENT N_R_Acc "" SWORD VCU_2023_CM_int16 0 0 -32768 32767 ECU_ADDRESS 0x4001803a /* @ECU_Address@N_R_Acc@ */ /end MEASUREMENT
/begin MEASUREMENT M_R_Acc "" SWORD VCU_2023_CM_int16 0 0 -32768 32767 ECU_ADDRESS 0x40018034 /* @ECU_Address@M_R_Acc@ */ /end MEASUREMENT
/begin MEASUREMENT REGID "" SWORD VCU_2023_CM_int16 0 0 -32768 32767 ECU_ADDRESS 0x4001804c /* @ECU_Address@REGID@ */ /end MEASUREMENT
/begin MEASUREMENT T_air "" SWORD VCU_2023_CM_int16 0 0 -32768 32767 ECU_ADDRESS 0x40018058 /* @ECU_Address@T_air@ */ /end MEASUREMENT
/begin MEASUREMENT T_motor "" SWORD VCU_2023_CM_int16 0 0 -32768 32767 ECU_ADDRESS 0x4001805c /* @ECU_Address@T_motor@ */ /end MEASUREMENT
/begin MEASUREMENT T_IGBT "" SWORD VCU_2023_CM_int16 0 0 -32768 32767 ECU_ADDRESS 0x40018054 /* @ECU_Address@T_IGBT@ */ /end MEASUREMENT
/begin MEASUREMENT I_cmd "" SWORD VCU_2023_CM_int16 0 0 -32768 32767 ECU_ADDRESS 0x40018028 /* @ECU_Address@I_cmd@ */ /end MEASUREMENT
/begin MEASUREMENT I_act_filt "" SWORD VCU_2023_CM_int16 0 0 -32768 32767 ECU_ADDRESS 0x40018024 /* @ECU_Address@I_act_filt@ */ /end MEASUREMENT
/begin MEASUREMENT Vdc_bus "" SWORD VCU_2023_CM_int16 0 0 -32768 32767 ECU_ADDRESS 0x40018074 /* @ECU_Address@Vdc_bus@ */ /end MEASUREMENT
/begin MEASUREMENT I_200 "" SWORD VCU_2023_CM_int16 0 0 -32768 32767 ECU_ADDRESS 0x40018022 /* @ECU_Address@I_200@ */ /end MEASUREMENT
/begin MEASUREMENT I_device "" SWORD VCU_2023_CM_int16 0 0 -32768 32767 ECU_ADDRESS 0x4001802a /* @ECU_Address@I_device@ */ /end MEASUREMENT
/begin MEASUREMENT I_max_pk "" SWORD VCU_2023_CM_int16 0 0 -32768 32767 ECU_ADDRESS 0x4001802e /* @ECU_Address@I_max_pk@ */ /end MEASUREMENT
/begin MEASUREMENT I_nom_eff "" SWORD VCU_2023_CM_int16 0 0 -32768 32767 ECU_ADDRESS 0x40018030 /* @ECU_Address@I_nom_eff@ */ /end MEASUREMENT
/begin MEASUREMENT I_max_eff "" SWORD VCU_2023_CM_int16 0 0 -32768 32767 ECU_ADDRESS 0x4001802c /* @ECU_Address@I_max_eff@ */ /end MEASUREMENT
/begin MEASUREMENT N_act_filt "" SWORD VCU_2023_CM_int16 0 0 -32768 32767 ECU_ADDRESS 0x4001803e /* @ECU_Address@N_act_filt@ */ /end MEASUREMENT
/begin MEASUREMENT SpeedRPMmax "" SWORD VCU_2023_CM_int16 0 0 -32768 32767 ECU_ADDRESS 0x4001804e /* @ECU_Address@SpeedRPMmax@ */ /end MEASUREMENT
/begin MEASUREMENT N_lim_neg "" SWORD VCU_2023_CM_int16 0 0 -32768 32767 ECU_ADDRESS 0x40018042 /* @ECU_Address@N_lim_neg@ */ /end MEASUREMENT
/begin MEASUREMENT N_lim_pos "" SWORD VCU_2023_CM_int16 0 0 -32768 32767 ECU_ADDRESS 0x40018044 /* @ECU_Address@N_lim_pos@ */ /end MEASUREMENT
/begin MEASUREMENT Tension "" SWORD VCU_2023_CM_int16 0 0 -32768 32767 ECU_ADDRESS 0x40018060 /* @ECU_Address@Tension@ */ /end MEASUREMENT
/begin MEASUREMENT stErrroaerazg "" UBYTE VCU_2023_CM_uint8 0 0 0 255 ECU_ADDRESS 0x40018078 /* @ECU_Address@stErrroaerazg@ */ /end MEASUREMENT
/begin MEASUREMENT LVS_PERCENT "" UBYTE VCU_2023_CM_uint8 0 0 0 255 ECU_ADDRESS 0x40018032 /* @ECU_Address@LVS_PERCENT@ */ /end MEASUREMENT
/begin MEASUREMENT PwrM_flgKeyOnDelay "" UBYTE VCU_2023_CM_boolean 0 0 0 1 ECU_ADDRESS 0x40018047 /* @ECU_Address@PwrM_flgKeyOnDelay@ */ /end MEASUREMENT
/begin MEASUREMENT PwrM_flgKeyOnRaw "" UBYTE VCU_2023_CM_boolean 0 0 0 1 ECU_ADDRESS 0x40018048 /* @ECU_Address@PwrM_flgKeyOnRaw@ */ /end MEASUREMENT
/begin MEASUREMENT APPS_implausibility "" UBYTE VCU_2023_CM_boolean 0 0 0 1 ECU_ADDRESS 0x4001800b /* @ECU_Address@APPS_implausibility@ */ /end MEASUREMENT
/begin MEASUREMENT APPS_PBM "" UBYTE VCU_2023_CM_boolean 0 0 0 1 ECU_ADDRESS 0x4001800a /* @ECU_Address@APPS_PBM@ */ /end MEASUREMENT
/begin MEASUREMENT TSBTN "" UBYTE VCU_2023_CM_boolean 0 0 0 1 ECU_ADDRESS 0x40018053 /* @ECU_Address@TSBTN@ */ /end MEASUREMENT
/begin MEASUREMENT R2D_btn "" UBYTE VCU_2023_CM_boolean 0 0 0 1 ECU_ADDRESS 0x4001804a /* @ECU_Address@R2D_btn@ */ /end MEASUREMENT
/begin MEASUREMENT BUZZ "" UBYTE VCU_2023_CM_boolean 0 0 0 1 ECU_ADDRESS 0x4001800e /* @ECU_Address@BUZZ@ */ /end MEASUREMENT
/begin MEASUREMENT FLWS "" UBYTE VCU_2023_CM_boolean 0 0 0 1 ECU_ADDRESS 0x40018020 /* @ECU_Address@FLWS@ */ /end MEASUREMENT
/begin MEASUREMENT FRGRUN "" UBYTE VCU_2023_CM_boolean 0 0 0 1 ECU_ADDRESS 0x40018021 /* @ECU_Address@FRGRUN@ */ /end MEASUREMENT
/begin MEASUREMENT PRE "" UBYTE VCU_2023_CM_boolean 0 0 0 1 ECU_ADDRESS 0x40018046 /* @ECU_Address@PRE@ */ /end MEASUREMENT
/begin MEASUREMENT AIR_plus "" UBYTE VCU_2023_CM_boolean 0 0 0 1 ECU_ADDRESS 0x40018001 /* @ECU_Address@AIR_plus@ */ /end MEASUREMENT
/begin MEASUREMENT AIR_moins "" UBYTE VCU_2023_CM_boolean 0 0 0 1 ECU_ADDRESS 0x40018000 /* @ECU_Address@AIR_moins@ */ /end MEASUREMENT
/begin MEASUREMENT DECHARGE "" UBYTE VCU_2023_CM_boolean 0 0 0 1 ECU_ADDRESS 0x40018014 /* @ECU_Address@DECHARGE@ */ /end MEASUREMENT
/begin MEASUREMENT TS "" UBYTE VCU_2023_CM_boolean 0 0 0 1 ECU_ADDRESS 0x40018052 /* @ECU_Address@TS@ */ /end MEASUREMENT
/begin MEASUREMENT R2D "" UBYTE VCU_2023_CM_boolean 0 0 0 1 ECU_ADDRESS 0x40018049 /* @ECU_Address@R2D@ */ /end MEASUREMENT
/begin MEASUREMENT DIS_btn "" UBYTE VCU_2023_CM_boolean 0 0 0 1 ECU_ADDRESS 0x40018015 /* @ECU_Address@DIS_btn@ */ /end MEASUREMENT
/begin COMPU_METHOD VCU_2023_CM_uint16 "Q = V" RAT_FUNC "%5.0" "" COEFFS 0 1 0 0 0 1 /end COMPU_METHOD
/begin COMPU_METHOD VCU_2023_CM_single "Q = V" RAT_FUNC "%8.6" "" COEFFS 0 1 0 0 0 1 /end COMPU_METHOD
/begin COMPU_METHOD VCU_2023_CM_int16 "Q = V" RAT_FUNC "%5.0" "" COEFFS 0 1 0 0 0 1 /end COMPU_METHOD
/begin COMPU_METHOD VCU_2023_CM_uint32 "Q = V" RAT_FUNC "%10.0" "" COEFFS 0 1 0 0 0 1 /end COMPU_METHOD
/begin COMPU_METHOD VCU_2023_CM_int16_V "Q = V" RAT_FUNC "%5.0" "V" COEFFS 0 1 0 0 0 1 /end COMPU_METHOD
/begin COMPU_METHOD VCU_2023_CM_int16_A "Q = V" RAT_FUNC "%5.0" "A" COEFFS 0 1 0 0 0 1 /end COMPU_METHOD
/begin COMPU_METHOD VCU_2023_CM_int16__C "Q = V" RAT_FUNC "%5.0" "°C" COEFFS 0 1 0 0 0 1 /end COMPU_METHOD
/begin COMPU_METHOD VCU_2023_CM_uint8 "Q = V" RAT_FUNC "%3.0" "" COEFFS 0 1 0 0 0 1 /end COMPU_METHOD
/begin COMPU_METHOD VCU_2023_CM_boolean "Q = V" RAT_FUNC "%1.0" "" COEFFS 0 1 0 0 0 1 /end COMPU_METHOD
/begin GROUP VCU_2023 "VCU_2023" /* Root */ ROOT /begin SUB_GROUP Root_Main Root_Power_Management_Example /end SUB_GROUP
 /begin REF_MEASUREMENT nvmAPPS1_max nvmAPPS1_min nvmAPPS2_max nvmAPPS2_min nvmAPPS_PBM nvmBRK_TH nvmI_200 nvmI_act_filt nvmI_act_filt_A nvmI_cmd nvmI_device nvmI_max_eff nvmI_max_pk nvmI_nom_eff nvmM_R_Acc nvmM_R_Dec nvmN_100 nvmN_R_Acc nvmN_R_Dec nvmN_act_filt nvmN_lim nvmN_lim_neg nvmN_lim_pos nvmSpeedRPMmax nvmT_IGBT nvmT_IGBT_deg nvmT_air nvmT_air_deg nvmT_motor nvmT_motor_deg nvmVdc_bus nvmVdc_bus_V nvm_R2D nvm_TS_ON vit_moy /end REF_MEASUREMENT
/end GROUP
/begin GROUP Root_Main "VCU_2023/Main"
 /begin SUB_GROUP S2_CANbus_Management S2_Data_processing S2_Main_Functionalities /end SUB_GROUP
/end GROUP
/begin GROUP Root_Power_Management_Example "VCU_2023/Power Management Example" /begin SUB_GROUP S3_Power_Off_Management /end SUB_GROUP /end GROUP
/begin GROUP S2_CANbus_Management "VCU_2023/Main/CANbus Management"
 /begin SUB_GROUP S5_Can_treatment_if_len_4_or_5 S5_Can_treatment_if_len_6 S5_Send_to_Dashboard /end SUB_GROUP
 /begin REF_MEASUREMENT DATA /end REF_MEASUREMENT
/end GROUP
/begin GROUP S2_Data_processing "VCU_2023/Main/Data processing" /begin SUB_GROUP S6_Electrical S6_Temperature /end SUB_GROUP /end GROUP
/begin GROUP S2_Main_Functionalities "VCU_2023/Main/Main Functionalities"
 /begin SUB_GROUP S7_Acceleration_Pedal_Position_Sensors S7_Brake_Pressure_Sensor S7_Ready_to_drive S7_Speed_Sensor S7_Tractive_System /end SUB_GROUP
/end GROUP
/begin GROUP S3_Power_Off_Management "VCU_2023/Power Management Example/Power Off Management" /begin SUB_GROUP S159_Get_flgKeyOn S159_TOfD_xxxx1 /end SUB_GROUP /end GROUP
/begin GROUP S5_Can_treatment_if_len_4_or_5 "VCU_2023/Main/CANbus Management/Can treatment if len=4 or 5"
 /begin SUB_GROUP S9_I_200 S9_I_act_filt S9_I_cmd S9_I_device S9_I_max_eff S9_I_max_pk S9_I_nom_eff S9_N_100 S9_N_Lim S9_N_Lim_neg S9_N_Lim_pos S9_N_act_filt S9_SpeedRPMmax S9_T_IGBT S9_T_air S9_T_motor S9_Vdc_bus /end SUB_GROUP
 /begin REF_MEASUREMENT REGID stErrroaerazg /end REF_MEASUREMENT
/end GROUP
/begin GROUP S5_Can_treatment_if_len_6 "VCU_2023/Main/CANbus Management/Can treatment if len=6" /begin SUB_GROUP S10_N_R_Acc___M_R_Acc S10_N_R_Dec___M_R_Dec /end SUB_GROUP /end GROUP
/begin GROUP S5_Send_to_Dashboard "VCU_2023/Main/CANbus Management/Send to Dashboard" /begin REF_CHARACTERISTIC SOC_cur /end REF_CHARACTERISTIC /begin REF_MEASUREMENT DIS_btn LVS_PERCENT Tension /end REF_MEASUREMENT /end GROUP
/begin GROUP S6_Electrical "VCU_2023/Main/Data processing/Electrical" /begin REF_CHARACTERISTIC Vdc_bus_V_cur /end REF_CHARACTERISTIC /begin REF_MEASUREMENT I_act_filt_A Vdc_bus_V /end REF_MEASUREMENT /end GROUP
/begin GROUP S6_Temperature "VCU_2023/Main/Data processing/Temperature"
 /begin REF_CHARACTERISTIC T_IGBT_conversion_cur T_air_conversion_cur T_motor_conversion_cur /end REF_CHARACTERISTIC
 /begin REF_MEASUREMENT T_IGBT_deg T_air_deg T_motor_deg /end REF_MEASUREMENT
/end GROUP
/begin GROUP S7_Acceleration_Pedal_Position_Sensors "VCU_2023/Main/Main Functionalities/Acceleration Pedal Position Sensors"
 /begin SUB_GROUP S108_APPS_reading_and_calibration S108_Check_APPS_Implausibility S108_Send_Torque_Command /end SUB_GROUP
/end GROUP
/begin GROUP S7_Brake_Pressure_Sensor "VCU_2023/Main/Main Functionalities/Brake Pressure Sensor" /begin REF_CHARACTERISTIC BRK_TH /end REF_CHARACTERISTIC /begin REF_MEASUREMENT BRK_PRESSURE /end REF_MEASUREMENT /end GROUP
/begin GROUP S7_Ready_to_drive "VCU_2023/Main/Main Functionalities/Ready to drive" /begin SUB_GROUP S110_Subsystem S110_Subsystem1 /end SUB_GROUP /end GROUP
/begin GROUP S7_Speed_Sensor "VCU_2023/Main/Main Functionalities/Speed Sensor" /begin SUB_GROUP S111_IPWM_Read S111_IPWM_Read1 /end SUB_GROUP /begin REF_MEASUREMENT VIT_MOY_ARR VIT_MOY_ARR_corrige VIT_RLWS VIT_RRWS /end REF_MEASUREMENT /end GROUP
/begin GROUP S7_Tractive_System "VCU_2023/Main/Main Functionalities/Tractive System" /begin SUB_GROUP S112_Subsystem S112_Triggered_Subsystem1 /end SUB_GROUP /begin REF_MEASUREMENT FRGRUN /end REF_MEASUREMENT /end GROUP
/begin GROUP S159_Get_flgKeyOn "VCU_2023/Power Management Example/Power Off Management/Get flgKeyOn" /begin REF_MEASUREMENT PwrM_flgKeyOnRaw /end REF_MEASUREMENT /end GROUP
/begin GROUP S159_TOfD_xxxx1 "VCU_2023/Power Management Example/Power Off Management/TOfD_xxxx1" /begin REF_MEASUREMENT PwrM_flgKeyOnDelay /end REF_MEASUREMENT /end GROUP
/begin GROUP S9_I_200 "VCU_2023/Main/CANbus Management/Can treatment if len=4 or 5/I_200" /begin REF_MEASUREMENT I_200 /end REF_MEASUREMENT /end GROUP
/begin GROUP S9_I_act_filt "VCU_2023/Main/CANbus Management/Can treatment if len=4 or 5/I_act_filt" /begin REF_MEASUREMENT I_act_filt /end REF_MEASUREMENT /end GROUP
/begin GROUP S9_I_cmd "VCU_2023/Main/CANbus Management/Can treatment if len=4 or 5/I_cmd" /begin REF_MEASUREMENT I_cmd /end REF_MEASUREMENT /end GROUP
/begin GROUP S9_I_device "VCU_2023/Main/CANbus Management/Can treatment if len=4 or 5/I_device" /begin REF_MEASUREMENT I_device /end REF_MEASUREMENT /end GROUP
/begin GROUP S9_I_max_eff "VCU_2023/Main/CANbus Management/Can treatment if len=4 or 5/I_max_eff" /begin REF_MEASUREMENT I_max_eff /end REF_MEASUREMENT /end GROUP
/begin GROUP S9_I_max_pk "VCU_2023/Main/CANbus Management/Can treatment if len=4 or 5/I_max_pk" /begin REF_MEASUREMENT I_max_pk /end REF_MEASUREMENT /end GROUP
/begin GROUP S9_I_nom_eff "VCU_2023/Main/CANbus Management/Can treatment if len=4 or 5/I_nom_eff" /begin REF_MEASUREMENT I_nom_eff /end REF_MEASUREMENT /end GROUP
/begin GROUP S9_N_100 "VCU_2023/Main/CANbus Management/Can treatment if len=4 or 5/N_100" /begin REF_MEASUREMENT N_100 /end REF_MEASUREMENT /end GROUP
/begin GROUP S9_N_Lim "VCU_2023/Main/CANbus Management/Can treatment if len=4 or 5/N_Lim" /begin REF_MEASUREMENT N_lim /end REF_MEASUREMENT /end GROUP
/begin GROUP S9_N_Lim_neg "VCU_2023/Main/CANbus Management/Can treatment if len=4 or 5/N_Lim_neg" /begin REF_MEASUREMENT N_lim_neg /end REF_MEASUREMENT /end GROUP
/begin GROUP S9_N_Lim_pos "VCU_2023/Main/CANbus Management/Can treatment if len=4 or 5/N_Lim_pos" /begin REF_MEASUREMENT N_lim_pos /end REF_MEASUREMENT /end GROUP
/begin GROUP S9_N_act_filt "VCU_2023/Main/CANbus Management/Can treatment if len=4 or 5/N_act_filt" /begin REF_MEASUREMENT N_act_filt /end REF_MEASUREMENT /end GROUP
/begin GROUP S9_SpeedRPMmax "VCU_2023/Main/CANbus Management/Can treatment if len=4 or 5/SpeedRPMmax" /begin REF_MEASUREMENT SpeedRPMmax /end REF_MEASUREMENT /end GROUP
/begin GROUP S9_T_IGBT "VCU_2023/Main/CANbus Management/Can treatment if len=4 or 5/T_IGBT" /begin REF_MEASUREMENT T_IGBT /end REF_MEASUREMENT /end GROUP
/begin GROUP S9_T_air "VCU_2023/Main/CANbus Management/Can treatment if len=4 or 5/T_air" /begin REF_MEASUREMENT T_air /end REF_MEASUREMENT /end GROUP
/begin GROUP S9_T_motor "VCU_2023/Main/CANbus Management/Can treatment if len=4 or 5/T_motor" /begin REF_MEASUREMENT T_motor /end REF_MEASUREMENT /end GROUP
/begin GROUP S9_Vdc_bus "VCU_2023/Main/CANbus Management/Can treatment if len=4 or 5/Vdc_bus" /begin REF_MEASUREMENT Vdc_bus /end REF_MEASUREMENT /end GROUP
/begin GROUP S10_N_R_Acc___M_R_Acc "VCU_2023/Main/CANbus Management/Can treatment if len=6/N_R_Acc | M R_Acc" /begin REF_MEASUREMENT M_R_Acc N_R_Acc /end REF_MEASUREMENT /end GROUP
/begin GROUP S10_N_R_Dec___M_R_Dec "VCU_2023/Main/CANbus Management/Can treatment if len=6/N_R_Dec | M_R_Dec" /begin REF_MEASUREMENT M_R_Dec N_R_Dec /end REF_MEASUREMENT /end GROUP
/begin GROUP S108_APPS_reading_and_calibration "VCU_2023/Main/Main Functionalities/Acceleration Pedal Position Sensors/APPS reading and calibration" /begin REF_CHARACTERISTIC APPS1_max APPS1_min APPS2_max APPS2_min /end REF_CHARACTERISTIC /begin REF_MEASUREMENT APPS1_calib APPS2_calib APPS_1 APPS_2 /end REF_MEASUREMENT /end GROUP
/begin GROUP S108_Check_APPS_Implausibility "VCU_2023/Main/Main Functionalities/Acceleration Pedal Position Sensors/Check APPS Implausibility" /begin REF_MEASUREMENT APPS_PBM APPS_implausibility /end REF_MEASUREMENT /end GROUP
/begin GROUP S108_Send_Torque_Command "VCU_2023/Main/Main Functionalities/Acceleration Pedal Position Sensors/Send Torque Command" /begin REF_MEASUREMENT TRQ_CMD_BAMOCAR /end REF_MEASUREMENT /end GROUP
/begin GROUP S110_Subsystem "VCU_2023/Main/Main Functionalities/Ready to drive/Subsystem" /begin REF_MEASUREMENT FLWS R2D_btn /end REF_MEASUREMENT /end GROUP
/begin GROUP S110_Subsystem1 "VCU_2023/Main/Main Functionalities/Ready to drive/Subsystem1" /begin SUB_GROUP S129_Enter_R2D_Mode /end SUB_GROUP /begin REF_MEASUREMENT BUZZ /end REF_MEASUREMENT /end GROUP
/begin GROUP S111_IPWM_Read "VCU_2023/Main/Main Functionalities/Speed Sensor/IPWM Read" /begin REF_MEASUREMENT DUTY_RRWS /end REF_MEASUREMENT /end GROUP
/begin GROUP S111_IPWM_Read1 "VCU_2023/Main/Main Functionalities/Speed Sensor/IPWM Read1" /begin REF_MEASUREMENT DUTY_RLWS /end REF_MEASUREMENT /end GROUP
/begin GROUP S112_Subsystem "VCU_2023/Main/Main Functionalities/Tractive System/Subsystem" /begin SUB_GROUP S147_Subsystem /end SUB_GROUP /begin REF_MEASUREMENT TSBTN /end REF_MEASUREMENT /end GROUP
/begin GROUP S112_Triggered_Subsystem1 "VCU_2023/Main/Main Functionalities/Tractive System/Triggered Subsystem1" /begin REF_MEASUREMENT AIR_moins AIR_plus DECHARGE PRE /end REF_MEASUREMENT /end GROUP
/begin GROUP S129_Enter_R2D_Mode "VCU_2023/Main/Main Functionalities/Ready to drive/Subsystem1/Enter R2D Mode" /begin REF_MEASUREMENT R2D /end REF_MEASUREMENT /end GROUP
/begin GROUP S147_Subsystem "VCU_2023/Main/Main Functionalities/Tractive System/Subsystem/Subsystem" /begin REF_MEASUREMENT TS /end REF_MEASUREMENT /end GROUP
/end MODULE
/end PROJECT
/* (add any file trailer comments here) */
/* EOF VCU_2023.a2l */
